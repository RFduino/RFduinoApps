/*
 * Very simple library for driving an OLED display connected via SSD1306 driver chip.
 * One such display is: http://www.amazon.com/gp/product/B00O2KDQBE/ref=s9_simh_gw_p147_d0_i2?pf_rd_m=ATVPDKIKX0DER&pf_rd_s=desktop-1&pf_rd_r=1ABTWJR1SYABM57H2H7X&pf_rd_t=36701&pf_rd_p=1970559082&pf_rd_i=desktop
 * but there are many examples on Amazon and eBay such as http://www.ebay.com/itm/170842973484 
 *
 * The code keeps a buffer of the display memory in PROGMEM. Each pixel on the display is one bit
 * in the buffer which can be "on" or "off" (1 or 0). "Drawing" on the display consists
 * of turning the appropriate bits on and off in the buffer, and then when ready, copying the entire 
 * buffer to the display. You may wish to store an initial image or "splash screen" in the buffer
 * to simplify startup.
 *
 * Adafruit makes a complete line of similar displays and has a richer library available
 * if more functionality is required. See: http://www.adafruit.com/category/63_98
 *
 * On RFduino I2C defaults to pins:
 *	  SCL: GPIO 5
 *	  SDA: GPIO 6
 *
 */
#include <OLEDDisplay.h>
#include <avr/pgmspace.h>
#include <Wire.h>
#include <assert.h>

//
// Standard ASCII 5x7 font stored in flash used to
// draw text on the display. This could be swapped out
// for a different font or be supplimented by others.
//
static const unsigned char font[] PROGMEM = {
	0x00, 0x00, 0x00, 0x00, 0x00,
	0x3E, 0x5B, 0x4F, 0x5B, 0x3E,
	0x3E, 0x6B, 0x4F, 0x6B, 0x3E,
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	0x00, 0x00, 0x00, 0x00, 0x00
};


// 8x13 font 
// 95 ASCII characters
static const unsigned char font2[] PROGMEM = {
	0x00, 0x00, 0x00, 0x00, 0x00, 0x00, 0x00, 0x00, 0x00, 0x00, 0x00, 0x00, 0x00,// space :32
	0x00, 0x00, 0x18, 0x18, 0x00, 0x00, 0x18, 0x18, 0x18, 0x18, 0x18, 0x18, 0x18,// ! :33
	0x00, 0x00, 0x00, 0x00, 0x00, 0x00, 0x00, 0x00, 0x00, 0x36, 0x36, 0x36, 0x36,
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	0x00, 0x00, 0x00, 0x00, 0x00, 0x00, 0x06, 0x8f, 0xf1, 0x60, 0x00, 0x00, 0x00  // :126
};


//
// The off screen memory buffer for the LCD 128 bits wide and 64 rows high
// Drawing is done in this buffer, than uploaded to the display to make it visible
// buffer size = SSD1306_LCDHEIGHT * SSD1306_LCDWIDTH / 8
//
static uint8_t buffer[] = {
	0x00, 0x00, 0x00, 0x00, 0x00, 0x00, 0x00, 0x00, 0x00, 0x00, 0x00, 0x00, 0x00, 0x00, 0x00, 0x00,
	0x00, 0x00, 0x00, 0x00, 0x00, 0x00, 0x00, 0x00, 0x00, 0x00, 0x00, 0x00, 0x00, 0x00, 0x00, 0x00,
	0x00, 0x00, 0x00, 0x00, 0x00, 0x00, 0x00, 0x00, 0x00, 0x00, 0x00, 0x00, 0x00, 0x00, 0x00, 0x00,
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	0x00, 0x00, 0x00, 0x00, 0x00, 0x00, 0x00, 0x00, 0x00, 0x00, 0x00, 0x00, 0x00, 0x00, 0x00, 0x00
};

OLEDDisplay::OLEDDisplay(uint8_t address)
{
	_address = address;
	_x = 0;
	_y = 0;
	_textSize = 2;
	_wordWrap = true;

	this->off();

	// Init sequence for 128x64 OLED module
	writeCommand(SSD1306_SETDISPLAYCLOCKDIV);            // 0xD5
	writeCommand(0x80);                                  // the suggested ratio 0x80
	writeCommand(SSD1306_SETMULTIPLEX);                  // 0xA8
	writeCommand(0x3F);
	writeCommand(SSD1306_SETDISPLAYOFFSET);              // 0xD3
	writeCommand(0x0);                                   // no offset
	writeCommand(SSD1306_SETSTARTLINE | 0x0);            // line #0
	writeCommand(SSD1306_CHARGEPUMP);                    // 0x8D
	//    if (vccstate == SSD1306_EXTERNALVCC) 
	//    { ssd1306_command(0x10); }
	//else 
	//{ 
	writeCommand(0x14);
	//}
	writeCommand(SSD1306_MEMORYMODE);                    // 0x20
	writeCommand(0x00);                                  // 0x0 act like ks0108
	writeCommand(SSD1306_SEGREMAP | 0x1);
	writeCommand(SSD1306_COMSCANDEC);
	writeCommand(SSD1306_SETCOMPINS);                    // 0xDA
	writeCommand(0x12);
	writeCommand(SSD1306_SETCONTRAST);                   // 0x81
	//    if (vccstate == SSD1306_EXTERNALVCC) 
	//    { ssd1306_command(0x9F); }
	//else 
	//{ 
	writeCommand(0xCF);
	//}
	writeCommand(SSD1306_SETPRECHARGE);                  // 0xd9
	//    if (vccstate == SSD1306_EXTERNALVCC) 
	//    { ssd1306_command(0x22); }
	//else 
	//{ 
	writeCommand(0xF1);
	//}
	writeCommand(SSD1306_SETVCOMDETECT);                 // 0xDB
	writeCommand(0x40);
	writeCommand(SSD1306_DISPLAYALLON_RESUME);           // 0xA4
	writeCommand(SSD1306_NORMALDISPLAY);                 // 0xA6
}

void OLEDDisplay::on(void)
{
	writeCommand(SSD1306_DISPLAYON);//--turn on oled panel
}

void OLEDDisplay::off(void)
{
	writeCommand(SSD1306_DISPLAYOFF);                    // 0xAE
}

void OLEDDisplay::clear(void)
{
	memset(buffer, 0, (SSD1306_LCDWIDTH*SSD1306_LCDHEIGHT / 8));
}

void OLEDDisplay::update(void)
{
	writeCommand(SSD1306_COLUMNADDR);
	writeCommand(0);   // Column start address (0 = reset)
	writeCommand(SSD1306_LCDWIDTH - 1); // Column end address (127 = reset)

	writeCommand(SSD1306_PAGEADDR);
	writeCommand(0); // Page start address (0 = reset)
	writeCommand(7); // Page end address

	for (uint16_t i = 0; i<(SSD1306_LCDWIDTH*SSD1306_LCDHEIGHT / 8); i++) {
		// send a bunch of data in one xmission
		Wire.beginTransmission(_address);
		Wire.write(0x40);
		for (uint8_t x = 0; x<16; x++) {
			Wire.write(buffer[i]);
			i++;
		}
		i--;
		Wire.endTransmission();
	}
}


/*
 * Draw a single pixel at the given location of the given color.
 *
 * "Drawing" is setting the appropriate bit in the buffer. Depending on
 * the color, the bit is set or cleared.
 * WHITE sets the bit, BLACK clears it and INVERSE toggles the bit.
 */
void OLEDDisplay::drawPixel(int16_t x, int16_t y, uint16_t color) 
{
	// Don't draw outside the screen
	if ((x < 0) || (x >= SSD1306_LCDWIDTH) 
		|| (y < 0) || (y >= SSD1306_LCDHEIGHT))
	{
		return;
	}

	switch (color)
	{
		case WHITE:   
			buffer[x+ (y/8)*SSD1306_LCDWIDTH] |=  (1 << (y&7)); 
			break;

		case BLACK:   
			buffer[x+ (y/8)*SSD1306_LCDWIDTH] &= ~(1 << (y&7)); 
			break;

		case INVERSE: 
			buffer[x+ (y/8)*SSD1306_LCDWIDTH] ^=  (1 << (y&7)); 
			break;

		default:
			assert(true);
			break;
	}
//	buffer[x + (y / 8)*SSD1306_LCDWIDTH] |= (1 << (y & 7));
}

// Bresenham's algorithm - thx wikpedia
void OLEDDisplay::drawLine(int16_t x0, int16_t y0,
	int16_t x1, int16_t y1,
	uint16_t color) {
	int16_t steep = abs(y1 - y0) > abs(x1 - x0);
	if (steep) {
		swap(x0, y0);
		swap(x1, y1);
	}

	if (x0 > x1) {
		swap(x0, x1);
		swap(y0, y1);
	}

	int16_t dx, dy;
	dx = x1 - x0;
	dy = abs(y1 - y0);

	int16_t err = dx / 2;
	int16_t ystep;

	if (y0 < y1) {
		ystep = 1;
	}
	else {
		ystep = -1;
	}

	for (; x0 <= x1; x0++) {
		if (steep) {
			drawPixel(y0, x0, color);
		}
		else {
			drawPixel(x0, y0, color);
		}
		err -= dy;
		if (err < 0) {
			y0 += ystep;
			err += dx;
		}
	}
}

void OLEDDisplay::drawFastVLine(int16_t x, int16_t y,
	int16_t h, uint16_t color) {
	// Update in subclasses if desired!
	drawLine(x, y, x, y + h - 1, color);
}

void OLEDDisplay::drawFastHLine(int16_t x, int16_t y,
	int16_t w, uint16_t color) {
	// Update in subclasses if desired!
	drawLine(x, y, x + w - 1, y, color);
}

void OLEDDisplay::fillRect(int16_t x, int16_t y, int16_t w, int16_t h,
	uint16_t color) {
	// Update in subclasses if desired!
	for (int16_t i = x; i<x + w; i++) {
		drawFastVLine(i, y, h, color);
	}
}

void OLEDDisplay::setLocation(uint x, uint y)
{
	_x = x;
	_y = y;
}

void OLEDDisplay::setTextSize(uint size)
{
	_textSize = size;
}

void OLEDDisplay::fillScreen(uint16_t color) 
{
	fillRect(0, 0, SSD1306_LCDWIDTH, SSD1306_LCDHEIGHT, color);
}

/*
 * Write the given character at the current display position.
 * This method is required from the Print class which is the parent
 * of this (OLEDDisplay) class.
 *
 * If the character is a newline '\n' drop a row and return to the left.
 * Carriage returns are ignored.
 */
size_t OLEDDisplay::write(uint8_t c)
{
	// If newline, drop down a line and go back to beginning of the line
	if (c == '\n') {
		_y += getCharacterHeight();
		_x = 0;
	}
	else if (c == '\r') {
		// skip carriage returns
	}
	else {
		// Draw the character at the current location
		this->drawChar(_x, _y, c, WHITE, BLACK, _textSize);

		// Update the location.
		// If at the end of the line, wrap to the next one if wrap is one
		_x += getCharacterWidth();
		if (_wordWrap && (_x > (SSD1306_LCDWIDTH - getCharacterWidth() ))) {
			_y += getCharacterHeight();
			_x = 0;
		}
	}
}

/*
 * Draw the given character at the given location.
 * The (x, y) location is the upper left of the bounding box of the character.
 */
void OLEDDisplay::drawChar(int16_t x, int16_t y, unsigned char c,
	uint16_t color, uint16_t bg, uint8_t size) 
{
	// If the character is totally off the display, don't draw it
	if ((x >= SSD1306_LCDWIDTH) ||  // Clip right
		(y >= SSD1306_LCDHEIGHT) || // Clip bottom
		((x + 6 * size - 1) < 0) || // Clip left
		((y + 8 * size - 1) < 0))   // Clip top
	{
		return;
	}

	for (int8_t i = 0; i<6; i++) 
	{
		uint8_t line;
		if (i == 5)
			line = 0x0;
		else
			line = pgm_read_byte_near(font + (c * 5) + i);
		for (int8_t j = 0; j<8; j++) {
			if (line & 0x1) 
			{
				if (size == 1) // default size
					drawPixel(x + i, y + j, color);
				else {  // big size
					fillRect(x + (i*size), y + (j*size), size, size, color);
				}
			}
			else if (bg != color) 
			{
				if (size == 1) // default size
					drawPixel(x + i, y + j, bg);
				else {  // big size
					fillRect(x + i*size, y + j*size, size, size, bg);
				}
			}
			line >>= 1;
		}
	}
}

/*
* Draw the given character at the given location.
* The (x, y) location is the upper left of the bounding box of the character.
*/
void OLEDDisplay::drawCharFont2(int16_t x, int16_t y, unsigned char c,
	uint16_t color, uint16_t bg, uint8_t size)
{
	// If the character is totally off the display, don't draw it
	if ((x >= SSD1306_LCDWIDTH) ||  // Clip right
		(y >= SSD1306_LCDHEIGHT) || // Clip bottom
		((x + 6 * size - 1) < 0) || // Clip left
		((y + 8 * size - 1) < 0))   // Clip top
	{
		return;
	}

	int base = (c - 32) * 13;

	Serial.print(c);
	Serial.print(" ");
	Serial.print(base);
	Serial.println();

	y += 12;
	for (int8_t i = 0; i < 13; i++)
	{
		uint8_t line = pgm_read_byte_near(font2 + (base + i));
		Serial.print(i);
		Serial.print(" = ");
		Serial.print(line, HEX);
		Serial.print(" bits:");

		for (int8_t j = 8; 0 < j; j--) 
		{
			if (line & 0x1)
			{
				Serial.print(" 1");
				if (size == 1) // default size
					drawPixel(x + j, y - i, color);
				else {  // big size
					fillRect(x + (j*size), y - (i*size), size, size, color);
				}
			}
			else if (bg != color) 
			{
				Serial.print(" 0");
				if (size == 1) // default size
					drawPixel(x + j, y - i, bg);
				else {  // big size
					fillRect(x + j*size, y - i*size, size, size, bg);
				}

			}
			line >>= 1;
		}
		Serial.println();
	}
}

/*
 * Draw the given bitmap at the x, y position using the given foreground and background colors.
 * The bitmap buffer must be in PROGMEM (flash) memory.
 * The (x, y) location is the upper left hand corner of where the bitmap is drawn.
 */
void OLEDDisplay::drawBitmap(uint x, uint y,
	const uint8_t *bitmap, 
	uint width, uint height,
	uint16_t color, uint16_t bg) 
{
	int16_t i, j, byteWidth = (width + 7) / 8;

	for (j = 0; j < height; j++) 
	{
		for (i = 0; i < width; i++) 
		{
			if (pgm_read_byte_near(bitmap + j * byteWidth + i / 8) & (128 >> (i & 7)))
			{
				drawPixel(x + i, y + j, color);
			}
			else {
				drawPixel(x + i, y + j, bg);
			}
		}
	}
}

/*
 * Returns the current character width for the textSize set.
 */
uint OLEDDisplay::getCharacterWidth()
{
	return _textSize * 6;
}

/*
* Returns the current character height for the textSize set.
*/
uint OLEDDisplay::getCharacterHeight()
{
	return _textSize * 8;
}

/*
 * Write the given command to the display.
 *
 * A command is written to the I2C bus by writting the display address
 * and follow that by the control message byte of 0. The command follows
 * the control byte and then communication is terminated.
 *
 * There isn't a reply to the command from the display.
 */
void OLEDDisplay::writeCommand(uint8_t command)
{
	uint8_t control = 0x00;   // Co = 0, D/C = 0
	Wire.beginTransmission(_address);
	Wire.write(control);
	Wire.write(command);
	Wire.endTransmission();
}
